#include <Wire.h> 
#include <Adafruit_GFX.h>
#include <Adafruit_SSD1306.h>

#include <DHT.h>

#include <SoftwareSerial.h>

// OLED 세팅
#define SCREEN_WIDTH 128 // OLED display width, in pixels
#define SCREEN_HEIGHT 64 // OLED display height, in pixels

#define OLED_RESET     -1 // Reset pin # (or -1 if sharing Arduino reset pin)
#define SCREEN_ADDRESS 0x3C ///< See datasheet for Address; 0x3D for 128x64, 0x3C for 128x32

Adafruit_SSD1306 display(SCREEN_WIDTH, SCREEN_HEIGHT, &Wire, OLED_RESET);

// 시리얼 통신 세팅
SoftwareSerial s(5,6);

// 초기화면 BMP
const unsigned char smile [] PROGMEM = {
  0xff, 0xff, 0xff, 0xff, 0xff, 0xff, 0xff, 0xff, 0xff, 0xff, 0xff, 0xff, 0xff, 0xff, 0xff, 0xff, 
  0xff, 0xff, 0xff, 0xff, 0xff, 0xff, 0xff, 0xff, 0xff, 0xff, 0xff, 0xff, 0xff, 0xff, 0xff, 0xff, 
  0xff, 0xff, 0xff, 0xff, 0xff, 0xff, 0xff, 0xff, 0xff, 0xff, 0xff, 0xff, 0xff, 0xff, 0xff, 0xff, 
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  0xff, 0xff, 0xff, 0xff, 0xff, 0xff, 0xff, 0xff, 0xff, 0xff, 0xff, 0xff, 0xff, 0xff, 0xff, 0xff
};

#define DHTPIN 7     // DHT11 입력 핀
#define DHTTYPE DHT11   // DHT11, 22, 21중 선택 -> DHT 11

DHT dht(DHTPIN, DHTTYPE);

// 인체감지센서 관련 변수들
int value = 0; // 인체감지 센서 값
int sensor = 4; // 인체감지 센서 입력핀

// 삼색 LED 입력 핀
const int LED1 = 9;
const int LED2 = 10;
const int LED3 = 11;

// 온습도 센서 입력 핀
float humidity = 0;
float temp = 0;
float fahrenheit = 0;
float d_index = 0;
float hic = 0;
//float hif = 0;

// LED 제어 변수(추후 시리얼 통신으로 값 변경가능), 기본 상태 : 켜짐
int tled = 1;
int fled = 1;

// 화재 경보기 관련 변수들
int ledPin = 13; // 화염 센서 LED
int flinput = 2; // 불꽃 감지 센서 2번 핀
int flsensval = 0;  // 불꽃 센서, 불꽃 감지 시 '0(=LOW 상태)' 염두!! 기본 '1(=HIGH 상태)'        
int gassensval = 0; // 가스 센서 센서 값은 '0-1023'
int pinSpeaker = 3; // 피에조 센서
int GasSensor = A0; // 가스 센서 입력 핀


void setup() {
  pinMode (sensor, INPUT);
  // 인체 감지 센서 값을 입력 받음
  pinMode(ledPin, OUTPUT);
  // 화염센서 LED를 출력으로 설정      
  pinMode(flinput, INPUT);
  // 불꽃 센서값을 입력 받음     
  pinMode(pinSpeaker, OUTPUT);
  // 스피커를 출력으로 설정 
  pinMode(GasSensor, INPUT);
  // 가스 센서값을 입력 받음
  pinMode(LED1, OUTPUT);
  pinMode(LED2, OUTPUT);
  pinMode(LED3, OUTPUT);
  // 삼색 LED를 출력으로 설정
  Serial.begin(115200);
  s.begin(115200);
  // 시리얼 통신 - 통신을 위해 보드레이트를 통일해야함. ESP8266 기본 보드레이트로 통일
  Serial.println(F("센서 테스트"));

  

// 디스플레이 작동 확인
  if(!display.begin(SSD1306_SWITCHCAPVCC, SCREEN_ADDRESS)) {
    Serial.println(F("SSD1306 allocation failed"));
    for(;;); // Don't proceed, loop forever
  }

// 문제없으면 초기화면 출력됨
  display.clearDisplay();
  display.drawBitmap(0, 0,  smile, 128, 64, WHITE);
  display.display();
  display.clearDisplay();

// 온습도 센서 시작
  dht.begin();
}

void loop() {
  // 센서값을 읽어들임
  value = digitalRead(sensor);
  gassensval = analogRead(GasSensor);
  flsensval = digitalRead(flinput);  
  humidity = dht.readHumidity();
  temp = dht.readTemperature();
  fahrenheit = dht.readTemperature(true);
  hic = dht.computeHeatIndex(temp, humidity, false);
  d_index = 0.81*temp + 0.01*humidity*(0.99*temp - 14.3)+46.3;

//  hif = dht.computeHeatIndex(fahrenheit, humidity);
 
   // 읽어들인 센서값을 시리얼 통신으로 보냄
    s.print(gassensval);
    s.print(",");
    s.print(flsensval);
    s.print(",");
    s.print(humidity);
    s.print(",");
    s.print(temp);
    s.print(",");
    s.print(fahrenheit);
    s.print(",");
    s.print(d_index);
    s.print(",");
    s.print(hic);
    s.print(",");
    s.print(fled);
    s.print(",");
    s.println(tled);
    //s.print(",");
    //s.println(pinSpeaker);

// ESP8266으로부터 신호가 오면 시리얼 통신으로 받음
    if(s.available() > 0)
    {
      String check_t = s.readStringUntil(',');
      tled = check_t.toInt();
      String check_fl = s.readStringUntil('\n');
      fled = check_fl.toInt();
      fled -= 2;
    }

// 온습도 센서 미작동 시 피드백
  if (isnan(humidity) || isnan(temp) || isnan(fahrenheit))  {
    Serial.println(F("DHT 센서의 값을 읽어올 수 없습니다."));
    display.clearDisplay();
    display.print(F("Error!! Not able to read value from DHT11"));
    display.display();
    return;
  }

// 센서 값에 따른 출력
  if (flsensval == HIGH && gassensval < 900) {            
    if (fled == 0)
      digitalWrite(ledPin, LOW);  
    else
      digitalWrite(ledPin, HIGH);
    playTone(0, 0);
    Serial.println(F("가스 센서 값이 정상이며, 불꽃이 감지되지 않았습니다. 가스 센서 값 : "));
    Serial.print(gassensval);
    Serial.println(F(", 불꽃 센서 OFF"));
    DhtSensPrint(humidity, temp, hic, d_index);
    DhtLEDout(d_index, tled);    
    if (value == HIGH) {
      OLED_Display(flsensval, gassensval, humidity, temp, hic, d_index);
      Serial.println(F("인체 감지 센서가 작동하여 디스플레이가 켜집니다!"));
    }
    delay(2500);
    }
    
  else if (flsensval == HIGH && gassensval >= 900) {            
    if (fled == 0)
      digitalWrite(ledPin, LOW);  
    else
      digitalWrite(ledPin, HIGH);  
    playTone(10, 300);
    Serial.println(F("가스 센서 값이 정상 수치보다 높습니다, 불꽃은 감지되지 않았습니다. 가스 센서 값 : "));
    Serial.print(gassensval);
    Serial.println(F(", 불꽃 센서 OFF"));
    DhtSensPrint(humidity, temp, hic, d_index);
    DhtLEDout(d_index, tled);

    if (value == HIGH) {
      OLED_Display(flsensval, gassensval, humidity, temp, hic, d_index);
      Serial.println(F("인체 감지 센서가 작동하여 디스플레이가 켜집니다!"));
    }
    delay(2500);
    }
    
  else if (flsensval == LOW && gassensval < 900) {            
    if (fled == 0)
      digitalWrite(ledPin, LOW);  
    else
      digitalWrite(ledPin, HIGH);  
    playTone(10, 500);
    Serial.println(F("가스 센서 값이 정상이나, 불꽃이 감지되었습니다. 가스 센서 값 : "));
    Serial.print(gassensval);
    Serial.println(F(", 불꽃 센서 ON"));
    DhtSensPrint(humidity, temp, hic, d_index);
    DhtLEDout(d_index, tled);

    if (value == HIGH) {
      OLED_Display(flsensval, gassensval, humidity, temp, hic, d_index);
      Serial.println(F("인체 감지 센서가 작동하여 디스플레이가 켜집니다!"));
    }    
    delay(2500);
    }
    
  else {
    if (fled == 0)
      digitalWrite(ledPin, LOW);  
    else
      digitalWrite(ledPin, HIGH); 
    playTone(800, 1200);
    Serial.println(F("화재가 발생하였습니다. 가스 센서 값 : "));
    Serial.print(gassensval);
    Serial.println(F(", 불꽃 센서 ON"));
    DhtSensPrint(humidity, temp, hic, d_index);
    DhtLEDout(d_index, tled);

    if (value == HIGH) {
      OLED_Display(flsensval, gassensval, humidity, temp, hic, d_index);
      Serial.println(F("인체 감지 센서가 작동하여 디스플레이가 켜집니다!"));
    }    
    delay(1000);    
    }
  delay(10);
  }

// 경보음 발생 함수
void playTone(long duration, int freq) {
  duration *= 1000;
  int period = (1.0 / freq) * 1000000;
  long elapsed_time = 0;
  while (elapsed_time < duration) {
    digitalWrite(pinSpeaker,HIGH);
    delayMicroseconds(period / 2);
    digitalWrite(pinSpeaker, LOW);
    delayMicroseconds(period / 2);
    elapsed_time += (period);
  }
}

// 삼색 LED 작동함수
void RGB_light(int red, int green, int blue)
{
  analogWrite(9, red);
  analogWrite(10, green);
  analogWrite(11, blue);
}

// 온습도 센서 시리얼 프린트 함수 (테스트용)
void DhtSensPrint(float h, float t, float hic, float d) {
  Serial.print(F("습도: "));
  Serial.print(h);
  Serial.print(F("%  온도: "));
  Serial.print(t);
  Serial.print(F("°C"));
  Serial.print(F("  체감 온도: "));
  Serial.print(hic);
  Serial.print(F("°C "));
  Serial.print(F("  불쾌 지수: "));
  Serial.print(d);
  Serial.print(F("\n"));
}

// DHT 값에 따른 LED 출력
void DhtLEDout(float d, int tled) {
  if (tled == 0) // 받아온 값이 0이면 모두 꺼버림
  {
    digitalWrite(LED1, LOW);
    digitalWrite(LED2, LOW);
    digitalWrite(LED3, LOW); 
  }
  else // 아니라면 조건에 따라 추력
  {
    if (d <= 68.00)
      RGB_light(0, 255, 255);
    else if (d > 68.00 && d <= 75.00)
      RGB_light(0, 255, 0);
    else if (d > 75.00 && d <= 80.00)
      RGB_light(128, 128, 0);
    else
      RGB_light(255, 0, 0);
  }
}

// 디스플레이 출력 관련 함수
void OLED_Display(int fl, int gas, int h, int t, float hic, float d) {

  display.clearDisplay();
  display.setTextSize(1); // 텍스트 크기
  display.setTextColor(WHITE); // 본인이 구입한 모델은 Black, White, Black+white 반전? 느낌으로만 작동하였음.
  display.setCursor(0,0);
  //display.println(" 입력 ") 시 " 입력 " 후 new line
  //display.print(" 입력 ") 시 " 입력 " 후 문장 이어쓰기 -> serial print와 동일하게 동작

  if (gas > 900) {
    display.print(F("Gas value high:"));
    display.println(gas);
  }
  else {
    display.print(F("Gas value normal:"));
    display.println(gas);                                                                                                                                                                                      
  }

  if (fl == LOW)
  display.println(F("Flame!"));
  else
  display.println(F("No flame dected"));
  
  display.print(F("\nHumidity: "));
  display.print(h);
  display.write(37);
  display.print(F("\nTemperature: "));
  display.print(t);
  display.drawCircle(93,33,1,WHITE);
  display.println(F(" C"));
  display.print(F("\n H.Index : "));
  display.print(hic);
  display.drawCircle(99,49,1,WHITE);
  display.println(F(" C"));
  display.print(F(" D.Index : "));
  display.print(d);
  if (fl == LOW && gas > 900) { 
    // 화재 발생 시 모두 초기화하고 불이야!! 출력
    display.clearDisplay();
    display.setCursor(0,0);
    display.setTextSize(3);
    display.print(F("FIRE!!!"));
    display.startscrolldiagright(0x00, 0x07);
    delay(1000);
    display.startscrolldiagleft(0x00, 0x07);
    delay(1000);
  }
  display.display();
  delay(100);
  display.clearDisplay();
}
